/dts-v1/;
/memreserve/ 0x90000000 0x00000100;

#include "m0052-kona.dtsi"
#include "m0052-kona-rumi.dtsi"

/ {
	model = "Qualcomm Technologies, Inc. kona RUMI";
	compatible = "qcom,kona-rumi", "qcom,kona", "qcom,rumi";
	qcom,board-id = <0x1000F 0>;
};
