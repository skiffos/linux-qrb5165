/dts-v1/;

#include "m0052-kona.dtsi"
#include "m0052-kona-mtp-ws.dtsi"

/ {
	model = "Qualcomm Technologies, Inc. kona MTP (WS)";
	compatible = "qcom,kona-mtp", "qcom,kona", "qcom,mtp";
	qcom,board-id = <0x03010008 0>;
};
