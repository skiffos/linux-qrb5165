/dts-v1/;

#include "m0052-qrb5165.dtsi"
#include "m0052-kona-v2.1-iot-rb5.dtsi"

/ {
	model = "Qualcomm Technologies, Inc. qrb5165 IOT RB5";
	compatible = "qcom,kona-iot", "qcom,kona", "qcom,iot";
	qcom,board-id = <11 3>;
};
