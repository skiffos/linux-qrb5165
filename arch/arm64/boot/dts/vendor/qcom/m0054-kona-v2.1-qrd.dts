/dts-v1/;

#include "m0054-kona-v2.1.dtsi"
#include "m0054-kona-qrd.dtsi"

/ {
	model = "Qualcomm Technologies, Inc. kona v2.1 QRD";
	compatible = "qcom,kona-qrd", "qcom,kona", "qcom,qrd";
	qcom,board-id = <11 0>;
};
