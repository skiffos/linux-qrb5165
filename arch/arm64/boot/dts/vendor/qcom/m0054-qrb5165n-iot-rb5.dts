/dts-v1/;

#include "m0054-qrb5165n.dtsi"
#include "m0054-qrb5165n-iot-rb5.dtsi"

/ {
	model = "Qualcomm Technologies, Inc. QRB5165N IOT RB5";
	compatible = "qcom,kona-iot", "qcom,kona", "qcom,iot";
	qcom,board-id = <11 3>;
};
