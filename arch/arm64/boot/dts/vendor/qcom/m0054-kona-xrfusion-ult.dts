/dts-v1/;

#include "m0054-kona.dtsi"
#include "m0054-kona-xrfusion-ult.dtsi"

/ {
	model = "Qualcomm Technologies, Inc. kona XR 5G UltraSound";
	compatible = "qcom,kona-mtp", "qcom,kona", "qcom,mtp";
	qcom,board-id = <0x30008 0>;
};
