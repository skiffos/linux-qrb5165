/dts-v1/;

#include "m0054-kona-v2.dtsi"
#include "m0054-kona-hdk.dtsi"

/ {
	model = "Qualcomm Technologies, Inc. kona HDK";
	compatible = "qcom,kona-hdk", "qcom,kona", "qcom,hdk";
	qcom,board-id = <0x01001F 0x01>;
};
