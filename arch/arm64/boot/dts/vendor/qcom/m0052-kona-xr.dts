/dts-v1/;

#include "m0052-kona.dtsi"
#include "m0052-kona-xr.dtsi"

/ {
	model = "Qualcomm Technologies, Inc. kona XR Standalone";
	compatible = "qcom,kona-mtp", "qcom,kona", "qcom,mtp";
	qcom,board-id = <0x10108 0>;
};
