/dts-v1/;

#include "m0052-kona-v2.dtsi"
#include "m0052-kona-qrd.dtsi"

/ {
	model = "Qualcomm Technologies, Inc. kona QRD";
	compatible = "qcom,kona-qrd", "qcom,kona", "qcom,qrd";
	qcom,board-id = <11 0>;
};
