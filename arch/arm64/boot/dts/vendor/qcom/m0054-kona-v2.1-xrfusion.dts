/dts-v1/;

#include "m0054-kona-v2.1.dtsi"
#include "m0054-kona-xrfusion.dtsi"

/ {
	model = "Qualcomm Technologies, Inc. kona v2.1 XR 5G Fusion";
	compatible = "qcom,kona-mtp", "qcom,kona", "qcom,mtp";
	qcom,board-id = <0x20008 0>;
};
