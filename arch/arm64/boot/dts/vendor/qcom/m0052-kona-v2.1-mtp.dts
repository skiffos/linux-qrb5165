/dts-v1/;

#include "m0052-kona-v2.1.dtsi"
#include "m0052-kona-mtp.dtsi"

/ {
	model = "Qualcomm Technologies, Inc. kona v2.1 MTP";
	compatible = "qcom,kona-mtp", "qcom,kona", "qcom,mtp";
	qcom,board-id = <0x10008 0>;
};
