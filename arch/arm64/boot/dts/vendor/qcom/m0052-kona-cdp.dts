/dts-v1/;

#include "m0052-kona.dtsi"
#include "m0052-kona-cdp.dtsi"

/ {
	model = "Qualcomm Technologies, Inc. kona CDP";
	compatible = "qcom,kona-cdp", "qcom,kona", "qcom,cdp";
	qcom,board-id = <0x10001 0>;
};
