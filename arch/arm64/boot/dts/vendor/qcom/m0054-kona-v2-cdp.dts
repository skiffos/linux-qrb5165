/dts-v1/;

#include "m0054-kona-v2.dtsi"
#include "m0054-kona-cdp.dtsi"

/ {
	model = "Qualcomm Technologies, Inc. kona CDP";
	compatible = "qcom,kona-cdp", "qcom,kona", "qcom,cdp";
	qcom,board-id = <0x10001 0>;
};
