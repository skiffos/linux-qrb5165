/dts-v1/;

#include "m0054-kona-v2.1.dtsi"
#include "m0054-kona-mtp-ws.dtsi"

/ {
	model = "Qualcomm Technologies, Inc. kona v2.1 MTP (WS)";
	compatible = "qcom,kona-mtp", "qcom,kona", "qcom,mtp";
	qcom,board-id = <0x03010008 0>;
};
